## totem-7racker-dongle/config/boards/shields/totem_7racker/Kconfig.defconfig
```kconfig
# Copyright (c) 2020 The ZMK Contributors
# SPDX-License-Identifier: MIT

if SHIELD_TOTEM_7RACKER_DONGLE

config ZMK_KEYBOARD_NAME
	default "totem dongle"
	
config ZMK_SPLIT_BLE_ROLE_CENTRAL
	default y
	
config ZMK_USB
	default y

endif

if SHIELD_TOTEM_7RACKER_LEFT || SHIELD_TOTEM_7RACKER_RIGHT || SHIELD_TOTEM_7RACKER_DONGLE 

config ZMK_SPLIT
	default y

config ZMK_BLE
	default y
	
endif
```

## totem-7racker-dongle/config/boards/shields/totem_7racker/Kconfig.shield
```kconfig
# Copyright (c) 2020 The ZMK Contributors
# SPDX-License-Identifier: MIT

config SHIELD_TOTEM_7RACKER_LEFT
	def_bool $(shields_list_contains,totem_7racker_left)
	select SPI

config SHIELD_TOTEM_7RACKER_RIGHT
	def_bool $(shields_list_contains,totem_7racker_right)
	select SPI

config SHIELD_TOTEM_7RACKER_DONGLE
	def_bool $(shields_list_contains,totem_7racker_dongle)
```

## totem-7racker/config/boards/shields/totem_7racker/Kconfig.defconfig
```kconfig
# Copyright (c) 2020 The ZMK Contributors
# SPDX-License-Identifier: MIT

if SHIELD_TOTEM_7RACKER_LEFT

config ZMK_KEYBOARD_NAME
	default "totem"

config ZMK_SPLIT_BLE_ROLE_CENTRAL
	default y

endif

if SHIELD_TOTEM_7RACKER_LEFT || SHIELD_TOTEM_7RACKER_RIGHT 

config ZMK_SPLIT
	default y

endif
```
